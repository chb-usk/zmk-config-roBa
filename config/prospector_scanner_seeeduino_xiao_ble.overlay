/*
 * Zephyr 3.5.0 (ZMK v0.3-branch) compatibility overlay for prospector_scanner.
 *
 * prospector-zmk-module v2.2.1 targets Zephyr 4.x which has MIPI DBI support
 * (CONFIG_MIPI_DBI, zephyr,mipi-dbi-spi compatible). Zephyr 3.5.0 lacks that
 * subsystem: the ST7789V must be defined directly under an SPI bus using the
 * older sitronix,st7789v binding (cmd-data-gpios instead of dc-gpios on parent).
 *
 * The module's prospector_scanner.overlay creates /mipi_dbi/st7789v@0.
 * This overlay removes that node and adds st7789v directly under spi3.
 */

/delete-node/ &{/mipi_dbi};

&spi3 {
	st7789v: st7789v@0 {
		compatible = "sitronix,st7789v";
		reg = <0>;
		spi-max-frequency = <20000000>;
		width = <280>;
		height = <240>;
		x-offset = <20>;
		y-offset = <0>;
		/* DC pin: active low selects command mode (D/CX LOW = command) */
		cmd-data-gpios = <&xiao_d 7 GPIO_ACTIVE_LOW>;
		reset-gpios = <&xiao_d 3 GPIO_ACTIVE_LOW>;
		vcom = <0x19>;
		gctrl = <0x35>;
		vrhs = <0x12>;
		vdvs = <0x20>;
		mdac = <0x60>;
		gamma = <0x01>;
		colmod = <0x05>;
		lcm = <0x2c>;
		porch-param = [0c 0c 00 33 33];
		cmd2en-param = [5a 69 02 01];
		pwctrl1-param = [a4 a1];
		pvgam-param = [D0 04 0D 11 13 2B 3F 54 4C 18 0D 0B 1F 23];
		nvgam-param = [D0 04 0C 11 13 2C 3F 44 51 2F 1F 1F 20 23];
		ram-param = [00 F0];
		rgb-param = [CD 08 14];
	};
};
