/*
 * Applied via EXTRA_DTC_OVERLAY_FILE (after all shield overlays) to replace
 * the Zephyr 4.x MIPI DBI ST7789V node with a direct SPI node for Zephyr 3.5.0.
 *
 * prospector-zmk-module v2.2.1 defines /mipi_dbi/st7789v@0 using the
 * "zephyr,mipi-dbi-spi" compatible (Zephyr 3.6+). Zephyr 3.5.0 lacks that
 * subsystem; the ST7789V driver uses SPI_DT_SPEC_INST_GET which requires the
 * device to be a direct child of an SPI bus.
 */

/delete-node/ &{/mipi_dbi};

&spi3 {
	st7789v: st7789v@0 {
		compatible = "sitronix,st7789v";
		reg = <0>;
		spi-max-frequency = <20000000>;
		width = <280>;
		height = <240>;
		x-offset = <20>;
		y-offset = <0>;
		/* DC pin: active low = command mode (D/CX LOW = command on ST7789V) */
		cmd-data-gpios = <&xiao_d 7 GPIO_ACTIVE_LOW>;
		reset-gpios = <&xiao_d 3 GPIO_ACTIVE_LOW>;
		vcom = <0x19>;
		gctrl = <0x35>;
		vrhs = <0x12>;
		vdvs = <0x20>;
		mdac = <0x60>;
		gamma = <0x01>;
		colmod = <0x05>;
		lcm = <0x2c>;
		porch-param = [0c 0c 00 33 33];
		cmd2en-param = [5a 69 02 01];
		pwctrl1-param = [a4 a1];
		pvgam-param = [D0 04 0D 11 13 2B 3F 54 4C 18 0D 0B 1F 23];
		nvgam-param = [D0 04 0C 11 13 2C 3F 44 51 2F 1F 1F 20 23];
		ram-param = [00 F0];
		rgb-param = [CD 08 14];
	};
};
